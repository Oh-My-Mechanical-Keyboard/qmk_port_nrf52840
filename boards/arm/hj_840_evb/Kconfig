## boards/arm/hj_840_evb/Kconfig
```kconfig
# nRF52840-M2 board configuration

# Copyright (c) 2020 makerdiary
# SPDX-License-Identifier: Apache-2.0

if BOARD_HJ_840_EVB

config BOARD_ENABLE_DCDC
	bool "DCDC mode"
	select SOC_DCDC_NRF52X
	default y

config BOARD_ENABLE_DCDC_HV
	bool "High Voltage DCDC converter"
	select SOC_DCDC_NRF52X_HV
	default y

# config BOARD_HAS_NRF5_BOOTLOADER
# 	bool "Board has nRF5 bootloader"
# 	default y
# 	help
# 	  If selected, applications are linked so that they can be loaded by Nordic
# 	  nRF5 bootloader.

endif # BOARD_HJ_840_EVB
```

## boards/arm/hj_840_evb/Kconfig.board
```kconfig
# Copyright (c) 2022 Nordic Semiconductor ASA
# SPDX-License-Identifier: Apache-2.0

config BOARD_HJ_840_EVB
	bool "HJ-840_EVB"
	depends on SOC_NRF52840_QIAA
```

## boards/arm/hj_840_evb/Kconfig.defconfig
```kconfig
# Copyright (c) 2022 Nordic Semiconductor ASA
# SPDX-License-Identifier: Apache-2.0

if BOARD_HJ_840_EVB

config BOARD
	default "hj_840_evb"

# To let the nRF5 bootloader load an application, the application
# must be linked after Nordic MBR, that is factory-programmed on the board.

# Nordic nRF5 booatloader exists outside of the partitions specified in the
# DTS file, so we manually override FLASH_LOAD_OFFEST to link the application
# correctly, after Nordic MBR.

# When building MCUBoot, MCUBoot itself will select USE_DT_CODE_PARTITION
# which will make it link into the correct partition specified in DTS file,
# so no override is necessary.

config FLASH_LOAD_OFFSET
	default 0x1000
	depends on BOARD_HAS_NRF5_BOOTLOADER && !USE_DT_CODE_PARTITION

if USB

config USB_NRFX
	default y

config USB_DEVICE_STACK
	default y

endif # USB

config IEEE802154_NRF5
	default y
	depends on IEEE802154

config BT_CTLR
   default BT

endif # BOARD_HJ_840_EVB
```

## boards/arm/hj_840_evb/hj_840_evb_defconfig
```kconfig
# Copyright (c) 2022 Nordic Semiconductor ASA
# SPDX-License-Identifier: Apache-2.0

CONFIG_SOC_SERIES_NRF52X=y
CONFIG_SOC_NRF52840_QIAA=y
CONFIG_BOARD_HJ_840_EVB=y

# Enable MPU
CONFIG_ARM_MPU=y

# enable GPIO
CONFIG_GPIO=y

# Enable UART driver
CONFIG_SERIAL=y

# enable console
CONFIG_CONSOLE=y
CONFIG_UART_CONSOLE=y

# additional board options
CONFIG_GPIO_AS_PINRESET=y

# Enable hardware stack protection
CONFIG_HW_STACK_PROTECTION=y
```
